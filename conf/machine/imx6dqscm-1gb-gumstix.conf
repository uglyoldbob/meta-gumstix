## conf/machine/imx6dqscm-1gb-gumstix.conf
```bitbake
#@TYPE: Machine
#@NAME: Freescale i.MX6QSCM EVB
#@SOC: i.MX6Q
#@DESCRIPTION: Machine configuration for Freescale i.MX6SCM EVB
#@MAINTAINER: Alejandro Sierra <alejandro.guiza@nxp.com>

require conf/machine/include/imx6sabresd-common.inc

SOC_FAMILY = "mx6:mx6q"

KERNEL_DEVICETREE = "imx6dqscm-1gb-gumstix.dtb"

UBOOT_CONFIG ??= "sd"
UBOOT_CONFIG[sd] = "mx6dqscm_1gb_gumstix_defconfig,sdcard"
UBOOT_CONFIG[mfgtool] = "mx6dqscm_1gb_gumstix_defconfig"

MACHINE_FIRMWARE_append = " linux-firmware-wl12xx linux-firmware-wl18xx"
MACHINE_EXTRA_RDEPENDS += " linux-firmware-wl18xx"
```
